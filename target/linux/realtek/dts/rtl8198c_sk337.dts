/dts-v1/;

/ {
	model = "SK337";
	compatible = "realtek,rtl8198c-sk337", "realtek,rtl8198c";

	/* Legacy board data; the 3.10 RTL8198C BSP does not consume DT at boot. */
	gpio-map {
		wps-led = <7>;      /* H7 */
		reset-button = <5>; /* H5 */
		wps-button = <6>;   /* H6 */
	};
};
